// ▄▄▄▄▄▄▄▄▄▄▄▄▄▄▄▄▄▄▄▄▄▄▄▄▄▄▄▄▄▄▄▄▄▄▄▄▄▄▄▄▄▄▄▄▄▄▄▄▄▄▄▄▄▄▄▄▄▄▄▄▄▄▄▄▄▄▄▄▄▄▄▄▄▄▄▄▄▄▄▄▄▄▄▄▄▄▄▄▄▄▄▄▄▄▄▄▄▄▄▄▄▄▄▄▄▄▄▄▄▄▄▄▄▄▄▄▄▄▄▄▄▄▄▄▄▄▄▄▄▄▄▄▄▄▄▄▄▄▄▄▄▄▄▄▄▄▄▄▄
//
//                                                  .---..---..---..---..---.        .---..---..---..---..---.
//                                                | Q || W || E || R || T |        | Y || U || I || O || P |
//                                                |---||---||---||---||---|        |---||---||---||---||---|
//                                                | A || S || D || F || G |        | H || J || K || L || ; |
//                                                |---||---||---||---||---|        |---||---||---||---||---|
//                                                | Z || X || C || V || B |        | N || M || , || . || / |
//                                                '---''---''---''---''---'        '---''---''---''---''---'
//                                                          ___   ___                        .----.   ___
//                                                          /  /  /  /                       / .--. \  \  \
//                                                        /__/  /__/                       | ( () ) |  \__\
//                                                            /__/                           \ '--' /
//                                                          (Thumb)                          '----'
//                                                                                          (Trackball)
// ▄▄▄▄▄▄▄▄▄▄▄▄▄▄▄▄▄▄▄▄▄▄▄▄▄▄▄▄▄▄▄▄▄▄▄▄▄▄▄▄▄▄▄▄▄▄▄▄▄▄▄▄▄▄▄▄▄▄▄▄▄▄▄▄▄▄▄▄▄▄▄▄▄▄▄▄▄▄▄▄▄▄▄▄▄▄▄▄▄▄▄▄▄▄▄▄▄▄▄▄▄▄▄▄▄▄▄▄▄▄▄▄▄▄▄▄▄▄▄▄▄▄▄▄▄▄▄▄▄▄▄▄▄▄▄▄▄▄▄▄▄▄▄▄▄▄▄▄▄
       

// #include <behaviors.dtsi>
// #include <dt-bindings/zmk/keys.h>
// #include <dt-bindings/zmk/bt.h>
// #include <dt-bindings/zmk/outputs.h>
#define CONFIG_WIRELESS // for some stuff


#define ZMK_BASE_LAYER(name, LT, RT, LM, RM, LB, RB, LH, RH)                   \
    ZMK_LAYER(                                                                 \
        name,                                                                  \
          LT       RT                                                          \
          LM       RM                                                          \
          LB       RB                                               \
          LH       RH \
    )
#include "zmk-helpers/key-labels/charybdis.h"
#include "base.keymap"
//#include "keymap/qwerty.keymap"
